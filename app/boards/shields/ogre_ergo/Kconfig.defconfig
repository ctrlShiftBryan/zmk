## app/boards/shields/ogre_ergo/Kconfig.defconfig
```kconfig
if SHIELD_OGRE_ERGO_LEFT

config ZMK_KEYBOARD_NAME
    default "ogre ergo -  left"

config ZMK_SPLIT_BLE_ROLE_CENTRAL
    default y

endif

if SHIELD_OGRE_ERGO_RIGHT

config ZMK_KEYBOARD_NAME
    default "ogre ergo -  right"

endif

if SHIELD_OGRE_ERGO_LEFT || SHIELD_OGRE_ERGO_RIGHT

config ZMK_SPLIT
    default y

endif
```

## app/boards/shields/ogre_ergo/Kconfig.shield
```kconfig
config SHIELD_OGRE_ERGO_LEFT
    def_bool $(shields_list_contains,my_board_left)

config SHIELD_OGRE_ERGO_RIGHT
    def_bool $(shields_list_contains,my_board_right)
```
